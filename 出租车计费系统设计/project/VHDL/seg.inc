-- WARNING: Do NOT edit the input and output ports in this file in a text
-- editor if you plan to continue editing the block that represents it in
-- the Block Editor! File corruption is VERY likely to occur.

-- Copyright (C) 1991-2009 Altera Corporation
-- Your use of Altera Corporation's design tools, logic functions 
-- and other software and tools, and its AMPP partner logic 
-- functions, and any output files from any of the foregoing 
-- (including device programming or simulation files), and any 
-- associated documentation or information are expressly subject 
-- to the terms and conditions of the Altera Program License 
-- Subscription Agreement, Altera MegaCore Function License 
-- Agreement, or other applicable license agreement, including, 
-- without limitation, that your use is for the sole purpose of 
-- programming logic devices manufactured by Altera and sold by 
-- Altera or its authorized distributors.  Please refer to the 
-- applicable agreement for further details.


-- Generated by Quartus II Version 9.0 (Build Build 132 02/25/2009)
-- Created on Thu May 08 14:21:39 2014

FUNCTION seg (clk, reset_n, minute_in[5..0], mileage_in[6..0], cost_in[9..0], mileage_counter_ge_in[3..0], mileage_counter_shi_in[3..0], minute_counter_ge_in[3..0], minute_counter_shi_in[3..0])
	RETURNS (seg_duan[7..0], seg_wei[7..0]);
